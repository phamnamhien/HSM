## Kconfig
```kconfig
menu "HSM Configuration"

    config HSM_MAX_DEPTH
        int "Maximum state hierarchy depth"
        default 8
        range 2 16
        help
            Maximum number of nested state levels supported.

    config HSM_HISTORY
        bool "Enable state history feature"
        default y
        help
            Enable the state history mechanism.

endmenu
```
